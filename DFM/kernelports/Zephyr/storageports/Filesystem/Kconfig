## DFM/kernelports/Zephyr/storageports/Filesystem/Kconfig
```kconfig
# Copyright (c) 2021 Percepio AB
# SPDX-License-Identifier: Apache-2.0

menu "Filesystem Config"

config PERCEPIO_DFM_CFG_STORAGE_PORT_FILESYSTEM_PATH
    string "Alert storage path"
    default "/dfm"
    help
        Specifies where to store DFM Alerts. DFM will create a directory called "alerts" in the
        specified path upon initialization.

endmenu # menu "FCB Config"
```

## DFM/kernelports/Zephyr/storageports/Flash/Kconfig
```kconfig
# Copyright (c) 2021 Percepio AB
# SPDX-License-Identifier: Apache-2.0

menu "FCB Config"

config PERCEPIO_DFM_CFG_STORAGE_PORT_FCB_SECTOR_COUNT
    int "Sector Count"
    default 1

config PERCEPIO_DFM_CFG_STORAGE_PORT_FCB_SECTOR_SIZE
    hex "Sector Size"
    default 0x10000
    help
       Specifies the sector size to use for the FCB in the dfm_partition, this
       should be a multiple of the underlying flash sector size (depends on
       the flash hardware organization) in which the dfm_partition resides.

endmenu # menu "FCB Config"
```

## TraceRecorder/config/Kconfig/Kconfig.StreamPort
```kconfig
# Copyright (c) 2025 Percepio AB
# SPDX-License-Identifier: Apache-2.0

menu "StreamPort Settings"
	choice PERCEPIO_TRC_CFG_STREAM_PORT
		prompt "StreamPort"
		default PERCEPIO_TRC_CFG_STREAM_PORT_RINGBUFFER

		config PERCEPIO_TRC_CFG_STREAM_PORT_ESP_IDF_APPTRACE
			bool "ESP-IDF APPTRACE"
			depends on (PERCEPIO_TRC_CFG_RECORDER_RTOS_ESPIDF_FREERTOS)

		config PERCEPIO_TRC_CFG_STREAM_PORT_RTT
			bool "RTT"
			depends on ((ARM || ARM64) && PERCEPIO_TRC_CFG_RECORDER_RTOS_ZEPHYR) || \
			PERCEPIO_TRC_CFG_RECORDER_RTOS_THREADX || \
			PERCEPIO_TRC_CFG_RECORDER_RTOS_FREERTOS
			select USE_SEGGER_RTT if PERCEPIO_TRC_CFG_RECORDER_RTOS_ZEPHYR

		config PERCEPIO_TRC_CFG_STREAM_PORT_ITM
			bool "ITM"
			depends on ((ARM || ARM64) && PERCEPIO_TRC_CFG_RECORDER_RTOS_ZEPHYR) || \
			PERCEPIO_TRC_CFG_RECORDER_RTOS_THREADX || \
			PERCEPIO_TRC_CFG_RECORDER_RTOS_FREERTOS

		config PERCEPIO_TRC_CFG_STREAM_PORT_RINGBUFFER
			bool "Ring Buffer"

		config PERCEPIO_TRC_CFG_STREAM_PORT_FILE
			bool "File"

		config PERCEPIO_TRC_CFG_STREAM_PORT_TCPIP
			bool "TCP/IP"
			depends on !PERCEPIO_TRC_CFG_RECORDER_RTOS_ZEPHYR
			select PERCEPIO_TRC_CFG_STREAM_PORT_USE_INTERNAL_BUFFER

		config PERCEPIO_TRC_CFG_STREAM_PORT_UDP
			bool "UDP"
			depends on !PERCEPIO_TRC_CFG_RECORDER_RTOS_ZEPHYR
			select PERCEPIO_TRC_CFG_STREAM_PORT_USE_INTERNAL_BUFFER

		config PERCEPIO_TRC_CFG_STREAM_PORT_STM32_USB_CDC
			bool "STM32 USB CDC"
			depends on !PERCEPIO_TRC_CFG_RECORDER_RTOS_ZEPHYR && \
			!PERCEPIO_TRC_CFG_RECORDER_RTOS_ESPIDF_FREERTOS

		config PERCEPIO_TRC_CFG_STREAM_PORT_ZEPHYR_SEMIHOST
			bool "Semihost"
			depends on PERCEPIO_TRC_CFG_RECORDER_RTOS_ZEPHYR && \
			QEMU_TARGET && SEMIHOST
	endchoice

if PERCEPIO_TRC_CFG_STREAM_PORT_RTT
orsource "../../streamports/Jlink_RTT/Kconfig"
endif

if PERCEPIO_TRC_CFG_STREAM_PORT_ITM
orsource "../../streamports/ARM_ITM/Kconfig"
endif

if PERCEPIO_TRC_CFG_STREAM_PORT_RINGBUFFER
orsource "../../streamports/RingBuffer/Kconfig"
endif

if PERCEPIO_TRC_CFG_STREAM_PORT_FILE
orsource "../../streamports/File/Kconfig"
endif

if PERCEPIO_TRC_CFG_STREAM_PORT_ZEPHYR_SEMIHOST
orsource "../../kernelports/Zephyr/streamports/Semihost/Kconfig"
endif

if PERCEPIO_TRC_CFG_STREAM_PORT_ESP_IDF_APPTRACE
orsource "../../kernelports/ESP-IDF_FreeRTOS/streamports/ESP_IDF_APPTRACE/Kconfig"
endif

if PERCEPIO_TRC_CFG_STREAM_PORT_TCPIP
orsource "../../streamports/TCPIP/Kconfig"
endif

if PERCEPIO_TRC_CFG_STREAM_PORT_UDP
orsource "../../streamports/UDP/Kconfig"
endif

if PERCEPIO_TRC_CFG_STREAM_PORT_STM32_USB_CDC
orsource "../../streamports/STM32_USB_CDC/Kconfig"
endif

endmenu # "StreamPort Selection"
```
